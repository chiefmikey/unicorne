#include QMK_KEYBOARD_H

// Layer definitions
enum layers {
    _BASE,
    _LOWER,
    _RAISE,
    _ADJUST
};

// Custom keycodes
enum custom_keycodes {
    EMAIL = SAFE_RANGE,
};

// Process custom keycodes
bool process_record_user(uint16_t keycode, keyrecord_t *record) {
    switch (keycode) {
        case EMAIL:
            if (record->event.pressed) {
                // Send your email address when the key is pressed
                SEND_STRING("fabian.gebhart@gmail.com");
            }
            break;
    }
    return true;
}

// Key aliases for readability
#define MT_LCTL_GRV MT(MOD_LCTL, KC_GRV)   // Control when held, Grave when tapped
#define MT_LALT_SPC MT(MOD_LALT, KC_SPC)   // Alt when held, Space when tapped
#define LT_ADJ_ENT  LT(_ADJUST, KC_ENT)    // Adjust layer when held, Enter when tapped
#define LT_LOW_SPC  LT(_LOWER, KC_SPC)     // Lower layer when held, Space when tapped
#define LT_RAI_BSLS LT(_RAISE, KC_BSLS)    // Raise layer when held, Backslash when tapped

// Keymap definition
const uint16_t PROGMEM keymaps[][MATRIX_ROWS][MATRIX_COLS] = {

/* _BASE Layer
 * ,-----------------------------------------.                    ,-----------------------------------------.
 * | ESC  |   Q  |   W  |   E  |   R  |   T  |                    |   Y  |   U  |   I  |   O  |   P  | BSPC |
 * |------+------+------+------+------+------|                    |------+------+------+------+------+------|
 * |Ctrl/`|   A  |   S  |   D  |   F  |   G  |                    |   H  |   J  |   K  |   L  |   ;  |  '   |
 * |------+------+------+------+------+------|                    |------+------+------+------+------+------|
 * | LSFT |   Z  |   X  |   C  |   V  |   B  |-------.    ,-------|   N  |   M  |   ,  |   .  |   /  | RSFT |
 * `-----------------------------------------/       /     \      \-----------------------------------------'
 *                   | LGUI |Alt/SPC|Adj/ENT|      /       \      |Low/SPC|Rai/\ |      |
 *                   `----------------------'     '---------''----------------------'
 */
[_BASE] = LAYOUT(
    KC_ESC,        KC_Q,    KC_W,    KC_E,    KC_R,    KC_T,                      KC_Y,    KC_U,    KC_I,    KC_O,    KC_P,     KC_BSPC,
    MT_LCTL_GRV,   KC_A,    KC_S,    KC_D,    KC_F,    KC_G,                      KC_H,    KC_J,    KC_K,    KC_L,    KC_SCLN,  KC_QUOT,
    KC_LSFT,       KC_Z,    KC_X,    KC_C,    KC_V,    KC_B,                      KC_N,    KC_M,    KC_COMM, KC_DOT,  KC_SLSH,  KC_RSFT,
                                    KC_LGUI, MT_LALT_SPC, LT_ADJ_ENT,            LT_LOW_SPC, LT_RAI_BSLS, _______
),

/* _LOWER Layer
 * ,-----------------------------------------.                    ,-----------------------------------------.
 * |   1  |   2  |   3  |   4  |   5  |   6  |                    |   7  |   8  |   9  |   0  |   =  |      |
 * |------+------+------+------+------+------|                    |------+------+------+------+------+------|
 * |  Tab |   @  |   $  |   [  |   (  |   {  |                    |   }  |   )  |   ]  |   -  |  Up  |  \   |
 * |------+------+------+------+------+------|                    |------+------+------+------+------+------|
 * |      |   &  |   #  |   %  |   !  |   +  |-------.    ,-------|   ^  |      | PgUp | Left | Down | Right|
 * `-----------------------------------------/       /     \      \-----------------------------------------'
 *                   |   *  |      |      |      /       \      |      |      |      |
 *                   `----------------------'     '---------''----------------------'
 */
[_LOWER] = LAYOUT(
    KC_1,    KC_2,    KC_3,    KC_4,    KC_5,    KC_6,                       KC_7,    KC_8,    KC_9,    KC_0,    KC_EQL,  KC_TRNS,
    KC_TAB,  KC_AT,   KC_DLR,  KC_LBRC, KC_LPRN, KC_LCBR,                    KC_RCBR, KC_RPRN, KC_RBRC, KC_MINS, KC_UP,   KC_BSLS,
    KC_TRNS, KC_AMPR, KC_HASH, KC_PERC, KC_EXLM, KC_PLUS,                    KC_CIRC, KC_TRNS, KC_PGUP, KC_LEFT, KC_DOWN, KC_RGHT,
                                     KC_ASTR, KC_TRNS, KC_TRNS,                KC_TRNS, KC_TRNS, _______
),

/* _RAISE Layer
 * ,-----------------------------------------.                    ,-----------------------------------------.
 * |      |   1  |   2  |   3  |   4  |   5  |                    |   6  |   (  |   )  |   -  |   +  | Play |
 * |------+------+------+------+------+------|                    |------+------+------+------+------+------|
 * | Caps |   -  |   =  |   [  |   ]  |   \  |                    |  F1  |  F2  |  F3  |  F4  | Vol+ |  F6  |
 * |------+------+------+------+------+------|                    |------+------+------+------+------+------|
 * |      |  ESC | LGUI | RALT | Caps |   "  |-------.    ,-------|  F7  |  F8  |  F9  | Prev | Vol- | Next |
 * `-----------------------------------------/       /     \      \-----------------------------------------'
 *                   |      |      |      |      /       \      |      |      |      |
 *                   `----------------------'     '---------''----------------------'
 */
[_RAISE] = LAYOUT(
    KC_TRNS, KC_1,    KC_2,    KC_3,    KC_4,    KC_5,                      KC_6,     KC_LPRN, KC_RPRN, KC_MINS, KC_PLUS,   KC_MPLY,
    KC_CAPS, KC_MINS, KC_EQL,  KC_LBRC, KC_RBRC, KC_BSLS,                   KC_F1,    KC_F2,   KC_F3,   KC_F4,   KC_VOLU,   KC_F6,
    KC_TRNS, KC_ESC,  KC_LGUI, KC_RALT, KC_CAPS, KC_DQUO,                   KC_F7,    KC_F8,   KC_F9,   KC_MPRV, KC_VOLD,   KC_MNXT,
                                     KC_TRNS, KC_TRNS, KC_TRNS,                KC_TRNS, KC_TRNS, _______
),

/* _ADJUST Layer
 * ,-----------------------------------------.                    ,-----------------------------------------.
 * | Reset|      |      |      |      |      |                    |      |      |      |      |      |      |
 * |------+------+------+------+------+------|                    |------+------+------+------+------+------|
 * |      |      |      |      |      |      |                    |      |      |      |      |      |      |
 * |------+------+------+------+------+------|                    |------+------+------+------+------+------|
 * |RGBTog|RGBRmd|RGBMod|RGBV+ |RGBV- |RGBH- |-------.    ,-------|RGBH+ |RGBS- |RGBS+ |RGBSp+|RGBSp-|RGBTog|
 * `-----------------------------------------/       /     \      \-----------------------------------------'
 *                   |BL Tog|BL Stp|      |      /       \      |BL -  |BL +  |      |
 *                   `----------------------'     '---------''----------------------'
 */
[_ADJUST] = LAYOUT(
    RESET,   _______, _______, _______, _______, _______,    _______, _______, _______, _______, _______, _______,
    _______, _______, _______, _______, _______, _______,    _______, _______, _______, _______, _______, _______,
    RGB_TOG, RGB_RMOD, RGB_MOD, RGB_VAI, RGB_VAD, RGB_HUD,   RGB_HUI, RGB_SAD, RGB_SAI, RGB_SPI, RGB_SPD, RGB_TOG,
                                     BL_TOGG, BL_STEP, _______,    BL_DEC, BL_INC, _______
)

};
